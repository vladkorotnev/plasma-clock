#include <device_config.h>

#if HAS(WORDNIK_API)

#include <views/idle_screens/word_of_the_day.h>
#include <service/wordnik.h>
#include <graphics/font.h>
#include <esp32-hal-log.h>

static char LOG_TAG[] = "WOTD";

static const uint8_t spr_book_data[] = {
    // By PiiXL
    // https://piiixl.itch.io/mega-1-bit-icons-bundle
    0x00, 0x00, 0x00, 0x00, 0x78, 0x3c, 0xfc, 0x7e, 0x86, 0xc2, 0xfa, 0xbe, 0x86, 0xc2, 0xfa, 0xbe, 
    0x86, 0xc2, 0xfa, 0xbe, 0xfe, 0xfe, 0x8e, 0xe2, 0x02, 0x80, 0xfc, 0x7e, 0x03, 0x80, 0x00, 0x00, 
    0x00, 0x00, 0x00, 0x04, 0x78, 0x3c, 0xfc, 0x76, 0x86, 0xce, 0xfa, 0xb6, 0x86, 0xce, 0xfa, 0xb6, 
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    0x86, 0xc2, 0xfa, 0xbe, 0xfe, 0xfe, 0x8e, 0xe2, 0x02, 0x80, 0xfc, 0x7e, 0x03, 0x80, 0x00, 0x00
};

static const ani_sprite_t book_icon = {
    .width = 16, .height = 16,
    .frames = 8,
    .screen_frames_per_frame = 4,
    .holdoff_frames = 8,
    .data = spr_book_data,
    .format = SPRFMT_HORIZONTAL
};

WordOfTheDayView::WordOfTheDayView() {
    font = find_font(FONT_STYLE_UI_TEXT);
    memset(word_buffer, 0, 32);
    memset(definition_buffer, 0, 256);

    strncpy(word_buffer, "Loading...", 31);
    strncpy(definition_buffer, "Transfer (a program or data) into memory, or into the central processor from storage.", 255);

    last_update = 0;
    
    animation = new AniSpriteView(&book_icon);
    animation->width = 16;
    add_composable(animation);

    top_line = new StringScroll(font);
    top_line->x_offset = animation->width;
    top_line->set_y_position(0);
    top_line->set_string(word_buffer);
    add_composable(top_line);

    bottom_line = new StringScroll(font);
    bottom_line->x_offset = animation->width;
    bottom_line->set_y_position(8);
    bottom_line->set_string(definition_buffer);
    add_composable(bottom_line);

    ESP_LOGV(LOG_TAG, "Init");
}

WordOfTheDayView::~WordOfTheDayView() {
    delete bottom_line;
}

void WordOfTheDayView::prepare() {
    TickType_t ts = wotd_get_last_update();
    if(ts != last_update) {
        last_update = ts;
        wotd_get_current(word_buffer, 32, definition_buffer, 256);
        ESP_LOGI(LOG_TAG, "New word of the day");
        top_line->set_string(word_buffer);
        bottom_line->set_string(definition_buffer);

        int width = std::max(top_line->string_width, bottom_line->string_width);
        if(top_line->string_width > HWCONF_DISPLAY_WIDTH_PX - top_line->x_offset) {
            top_line->string_width = width;
        }
        if(bottom_line->string_width > HWCONF_DISPLAY_WIDTH_PX - bottom_line->x_offset) {
            bottom_line->string_width = width;
        }
    }

    Screen::prepare();
}

int WordOfTheDayView::desired_display_time() {
    return (bottom_line->estimated_frame_count() * 1000 / 58) + 2000; 
}

#endif